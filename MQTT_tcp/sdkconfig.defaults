## MQTT_tcp/sdkconfig.defaults
```kconfig
CONFIG_BROKER_URL="mqtt://192.168.1.70:1883"

CONFIG_EXAMPLE_WIFI_SSID="Wifi-Repeater"
CONFIG_EXAMPLE_WIFI_PASSWORD="j_arvan1t1s"
CONFIG_OTA_ALLOW_HTTP=y
```

## simple_ota_example/sdkconfig.defaults
```kconfig
# Default sdkconfig parameters to use the OTA
# partition table layout, with a 4MB flash size
CONFIG_ESPTOOLPY_FLASHSIZE_4MB=y
CONFIG_PARTITION_TABLE_TWO_OTA=y

CONFIG_EXAMPLE_FIRMWARE_UPGRADE_URL="http://192.168.1.70:8070/hello-world.bin"

CONFIG_EXAMPLE_WIFI_SSID="Wifi-Repeater"
CONFIG_EXAMPLE_WIFI_PASSWORD="j_arvan1t1s"
CONFIG_OTA_ALLOW_HTTP=y
```
